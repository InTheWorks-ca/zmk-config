## config/boards/arm/intheworks/Kconfig.defconfig
```kconfig
if BOARD_INTHEWORKS

config BOARD
	default "intheworks"

config ZMK_KEYBOARD_NAME
	default "InTheWorks"

if USB

config USB_NRFX
	default y

config USB_DEVICE_STACK
	default y

endif # USB

config BT_CTLR
	default BT

config ZMK_BLE
	default y

config ZMK_USB
	default y

endif # BOARD_INTHEWORKS
```

## config/west.yml
```yaml
manifest:
  remotes:
    - name: zmkfirmware
      url-base: https://github.com/zmkfirmware
    - name: intheworks
      url-base: https://github.com/InTheWorks-ca
  projects:
    - name: zmk
#      remote: intheworks
#      revision: intheworks-test
      remote: zmkfirmware
      revision: main
      import: app/west.yml
  self:
    path: config
```
